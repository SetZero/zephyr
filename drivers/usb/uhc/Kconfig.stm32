## drivers/usb/uhc/Kconfig.stm32
```kconfig
# Copyright (c) 2026
# SPDX-License-Identifier: Apache-2.0

config UHC_STM32
	bool "STM32 OTG_HS host controller driver"
	default y
	depends on DT_HAS_ST_STM32_OTGHS_UHC_ENABLED
	select STM32_USB_COMMON
	select USE_STM32_HAL_HCD
	select USE_STM32_LL_PWR
	select EVENTS
	help
	  STM32 USB host controller driver: operates an OTG_HS instance
	  in host mode through the STM32Cube HAL HCD layer.

if UHC_STM32

config UHC_STM32_THREAD_STACK_SIZE
	int "UHC STM32 driver internal thread stack size"
	default 1024
	help
	  Stack size of the driver thread that performs port state
	  handling and transfer scheduling.

config UHC_STM32_THREAD_PRIORITY
	int "UHC STM32 driver thread priority"
	default 8
	help
	  Preemptible priority of the driver thread. Must be able to
	  preempt the application main loop so that mouse/HID polling
	  stays responsive.

endif # UHC_STM32
```

## dts/bindings/usb/st,stm32-otghs-uhc.yaml
```yaml
# Copyright (c) 2026
# SPDX-License-Identifier: Apache-2.0

description: |
  STM32 USB OTG High-Speed controller operated in HOST mode through the
  UHC (USB host controller) driver API.

  Assign this compatible to an OTG_HS instance node (replacing the
  device-mode "st,stm32-otghs" compatible) to hand the instance to the
  uhc_stm32 driver, e.g. in a board overlay:

    zephyr_uhc0: &usbotg_hs2 {
        compatible = "st,stm32-otghs-uhc";
        status = "okay";
    };

  The device-mode compatible must not be present on the same node, or
  the device-mode drivers would also claim the instance.

compatible: "st,stm32-otghs-uhc"

include: usb-controller.yaml

properties:
  reg:
    required: true

  interrupts:
    required: true

  clocks:
    required: true
    description: |
      Core clock gate (and optionally the PHY reference clock source
      selection as the second element), identical to the device-mode
      binding of the instance.

  phys:
    type: phandles
    required: true
    description: PHY provider (embedded HS PHY, e.g. st,stm32-usbphyc).

  num-bidir-endpoints:
    type: int
    description: Number of bi-directional endpoints supported by the core.

  ram-size:
    type: int
    description: |
      Size of the shared endpoint FIFO RAM in bytes.
```

## subsys/usb/host/class/Kconfig.hid
```kconfig
# Copyright (c) 2026
# SPDX-License-Identifier: Apache-2.0

config USBH_HID_CLASS
	bool "USB host HID class, boot-protocol mouse [EXPERIMENTAL]"
	select EXPERIMENTAL
	select INPUT
	help
	  Host-side HID class driver limited to the boot-protocol mouse.
	  Reports are delivered through the input subsystem as relative
	  pointer events (INPUT_REL_X/Y/WHEEL, INPUT_BTN_LEFT/RIGHT/MIDDLE).

if USBH_HID_CLASS

module = USBH_HID
module-str = usbh hid
source "subsys/logging/Kconfig.template.log_config"

endif # USBH_HID_CLASS
```
